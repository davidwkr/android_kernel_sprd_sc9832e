## Documentation/devicetree/bindings/input/misc/sc7a22.txt
```
Sensortek SC7A22/SC7A20 three-axis accelerometer

Required properties:
- compatible: must be "sprd,sc7a22"
- reg: I2C address of the sensor

Optional properties:
- layout: mounting orientation from 0 through 7. Defaults to 0. Written to the
  orientation register as layout | 0x70.
- angle: hand-up angle, written to the hand-up angle register. Defaults to 10.
  The K18 stock tree uses 0x75.
- irq-gpio: GPIO of the chip's interrupt line (level high). Without it the
  hand-raise key is not available.
- hand-up-ctrl: value for the hand-up control register (0x08) of the 0x13
  part. Defaults to 0x11 (the DM63 and MT107 stock firmware); the K18 and
  DW100U stock firmware writes 0x21.

Example:

	sc7a22_acc@18 {
		compatible = "sprd,sc7a22";
		reg = <0x18>;
		layout = <0>;
		angle = <0x75>;
		irq-gpio = <&gpio 93 0>;
	};
```

## Documentation/devicetree/bindings/power/supply/sc2720_charger.txt
```
Spreadtrum SC2720/SC2721 PMIC battery charger binding

Required properties:
 - compatible: Should be "sprd,sc2720-charger" or "sprd,sc2721-charger".
 - reg: Address offset of charger register (CHGR_CTRL0; CHGR_CTRL1 follows at
   +0x4). For the SC2721 this is 0xec0.
 - phys: Contains a phandle to the USB phy.
 - nvmem-cells, nvmem-cell-names: the CCCV calibration. "cccv_calib" is
   required for both chips (6 bits). The SC2721 additionally requires
   "cccv_calib_valid" (efuse valid flag, bit 0 of efuse block 0); when the flag
   is clear the calibration defaults to 0x20. Probe fails if a required cell
   is missing.

Optional Properties:
- monitored-battery: phandle of battery characteristics devicetree node.
  The charger uses the following battery properties:
- charge-term-current-microamp: current for charge termination phase.
- constant-charge-voltage-max-microvolt: maximum constant input voltage.
- sprd,ovp-microvolt: (SC2721 only) input over voltage protection level in
  microvolts. Clamped to 5600000..9000000 and programmed in 100 mV steps into
  CHGR_CTRL1 bits 5..0 as (mV - 5600) / 100, with the charge current enable
  cleared around the write (the 4.4 sprdchg_set_chg_ovp()). When absent the
  register keeps the value it has and a warning is printed once.
  See Documentation/devicetree/bindings/power/supply/battery.txt
- sprd,charge-start-by-cm: boolean. charger-manager owns the decision to
  charge: on an adapter notification the driver only reports online and the
  adapter type and does not start a charge, it starts one only when
  charger-manager writes the STATUS property (after it has programmed the
  temperature zone current and CV). Without it the driver starts the charge
  by itself, as before.

SC2721 notes:
- The charge current is clamped to 300..1300 mA in 50 mA steps and the
  constant charge voltage to what END_V 0..2 and the 6 bit CV code can
  represent; the input over voltage protection is only programmed when
  sprd,ovp-microvolt is given.
- The module parameter sc2720_charger.cv_override_mv (4000..4400 mV, 0 = off)
  caps the constant charge voltage of the SC2721 charger. See
  devices/SC2721_CHARGER_MAP.md.

Example:

	bat: battery {
		compatible = "simple-battery";
		charge-term-current-microamp = <120000>;
		constant-charge-voltage-max-microvolt = <4350000>;
		......
	};

	sc2720_pmic: pmic@0 {
		compatible = "sprd,sc2720";
		reg = <0>;
		spi-max-frequency = <26000000>;
		interrupts = <GIC_SPI 31 IRQ_TYPE_LEVEL_HIGH>;
		interrupt-controller;
		#interrupt-cells = <2>;
		#address-cells = <1>;
		#size-cells = <0>;

		charger@0 {
			compatible = "sprd,sc2720-charger";
			reg = <0x0>;
			phys = <&ssphy>;
			monitored-battery = <&bat>;
		};
	};
```

## drivers/gpu/arm/Kconfig
```kconfig
menu "ARM GPU Configuration"
source "drivers/gpu/arm/midgard_r21p0/Kconfig"
endmenu
```

## drivers/input/fingerprint/Kconfig
```kconfig
# SPDX-License-Identifier: GPL-2.0
menuconfig INPUT_FINGERPRINT
	bool "Fingerprint sensor drivers"
	depends on INPUT
	help
	  Say Y here to list fingerprint sensor drivers. This only
	  enables the menu; it does not build any driver by itself.

if INPUT_FINGERPRINT

source "drivers/input/fingerprint/goodix/Kconfig"

endif
```

## drivers/input/fingerprint/goodix/Kconfig
```kconfig
# SPDX-License-Identifier: GPL-2.0
config GOODIX_TEE_FINGERPRINT
	bool "Goodix fingerprint sensor (TEE/HAL interface)"
	depends on SPI && OF && OF_GPIO && FB && INPUT_FINGERPRINT
	help
	  Kernel side of the Goodix fingerprint HAL: /dev/goodix_fp ioctls,
	  a netlink socket for IRQ and screen events, and the "gf-keys"
	  input device. Binds to compatible "goodix,fingerprintree".
	  Derived from the GPL Goodix driver, see gf_common.c.
	  If unsure, say N.
```

## drivers/media/gsp/Kconfig
```kconfig
config SPRD_GSP
	bool "SPRD GSP driver"
	depends on ARCH_SPRD
	depends on ION_SPRD
	depends on SYNC_FILE
	depends on SPRD_IOMMU
	# binds the same sprd,gsp-lite_r2p0-sharkle node
	depends on !DRM_SPRD_GSP
	---help---
	  GSP is hardware which not only can compose multiple layers
	  but also can transform and scale layers.

	  This is the 4.4 driver of the Android 8.1 stock userspace (/dev/gsp,
	  used by gsp.sp9832e.so), cut down to the sharkle lite_r2p0 core.
	  Say N if the DRM GSP driver is used instead.
```

## drivers/misc/sprd_camera/dcam/Kconfig
```kconfig
config SPRD_CAMERA_DCAM_IF_R4P0
    bool "Spreadtrum Camera DCAM IF R4P0"
    depends on SPRD_CAMERA
    help
        This is DCAM_IF_R4P0 driver for Spreadtrum SOCs
        and sharle, if you want to use this config,
        please to read spec and driver code,
        they can help you to use r4p0 driver
```

## drivers/misc/sprd_camera/sensor/Kconfig
```kconfig
config SPRD_CAMERA_CSI_R2P0V2
    bool "Spreadtrum Camera CSI2 R2P0 Version 2.0"
    depends on SPRD_CAMERA
    help
        This is a CSI conecting synopsys DPHY driver for Spreadtrum SOCs.
```

## drivers/staging/android/ion/Kconfig
```kconfig
menuconfig ION
	bool "Ion Memory Manager"
	depends on HAVE_MEMBLOCK && HAS_DMA && MMU
	select GENERIC_ALLOCATOR
	select DMA_SHARED_BUFFER
	---help---
	  Chose this option to enable the ION Memory Manager,
	  used by Android to efficiently allocate buffers
	  from userspace that can be shared between drivers.
	  If you're not using Android its probably safe to
	  say N here.

config ION_SYSTEM_HEAP
	bool "Ion system heap"
	depends on ION
	help
	  Choose this option to enable the Ion system heap. The system heap
	  is backed by pages from the buddy allocator. If in doubt, say Y.

config ION_CARVEOUT_HEAP
	bool "Ion carveout heap support"
	depends on ION
	help
	  Choose this option to enable carveout heaps with Ion. Carveout heaps
	  are backed by memory reserved from the system. Allocation times are
	  typically faster at the cost of memory not being used. Unless you
	  know your system has these regions, you should say N here.

config ION_CHUNK_HEAP
	bool "Ion chunk heap support"
	depends on ION
	help
          Choose this option to enable chunk heaps with Ion. This heap is
	  similar in function the carveout heap but memory is broken down
	  into smaller chunk sizes, typically corresponding to a TLB size.
	  Unless you know your system has these regions, you should say N here.

config ION_CMA_HEAP
	bool "Ion CMA heap support"
	depends on ION && DMA_CMA
	help
	  Choose this option to enable CMA heaps with Ion. This heap is backed
	  by the Contiguous Memory Allocator (CMA). If your system has these
	  regions, you should say Y here.

config ION_SPRD
	tristate "Ion for Spreadtrum"
	depends on ION
	help
	  Choose this option if you wish to use ion on an Spreadtrum chip.
	  Provides a ION driver that registers some base heaps.

config SPRD_ION_RESTRICT_PHYS
	bool "Restrict ION physical address queries to non-app callers"
	depends on ION_SPRD
	default n
	help
	  The legacy ION_SPRD_CUSTOM_PHYS custom command and ION_IOC_PHY
	  return the physical address of any dma-buf the caller can import,
	  which gives an ordinary app a physical address oracle (useful for
	  DMA-based attacks). With this option both return -EPERM to callers
	  whose app id (uid % 100000, so secondary users and isolated uids
	  are included) is >= 10000 (Android AID_APP), unless the caller has
	  CAP_SYS_RAWIO or its full uid is listed in the
	  sprd_ion.phys_allow_uids boot parameter. Callers with an app id
	  below 10000 (root, system, media, cameraserver, camera,
	  graphics ...) are not affected, so the stock vendor HALs are
	  expected to keep working. Each denial logs the comm and uid (rate
	  limited). Same policy as the 4.4 tree's option of this name.
	  Trade-off: any app-uid process that legitimately uses these calls
	  breaks unless allow-listed. Not verified on hardware. If unsure,
	  say N.
```

## drivers/video/adf/sprd/Kconfig
```kconfig
config ADF_SPRD
	depends on ADF
	depends on !DRM_SPRD
	select VIDEOMODE_HELPERS
	select SPRD_PANEL_NOTIFIER
	bool "Enable adf driver for spreadtrum"
	help
	  This driver implements adf core to enable spreadtrum
	  adf support.

	  Mutually exclusive with CONFIG_DRM_SPRD: the two drivers probe the
	  same dispc/DSI/DPHY hardware, so only one display stack may be
	  active on a given board. Pick this one to keep the stock Android
	  8.1 ADF-based hwcomposer/gralloc (hwcomposer.sp9832e.so,
	  gralloc.sp9832e.so, both libadf consumers) working unmodified;
	  pick CONFIG_DRM_SPRD for a DRM/KMS userspace instead.
source "drivers/video/adf/sprd/drv/Kconfig"
```

## drivers/video/adf/sprd/drv/Kconfig
```kconfig
config DISP_R1P0
	depends on ADF
	bool "Enable disp r1p0 driver for spreadtrum"
	help
	  This driver implements disp r1p0 driver to enable spreadtrum
	  disp r1p0 support.

config DISP_LITE_R2P0
	depends on ADF
	bool "Enable disp lite r2p0 driver for spreadtrum"
	help
	This driver implements disp lite r2p0 driver to enable spreadtrum
	disp lite r2p0 support.

config SPRD_AOD_IDLE
	tristate "Panel idle mode (AOD) and double-tap wake for SC9832E watches"
	depends on ADF_SPRD && BACKLIGHT_CLASS_DEVICE && INPUT
	default n
	help
	  Switches the MIPI-DSI OLED panel (CO5300) between normal and idle
	  mode (DCS 0x38/0x39) from /sys/kernel/aod_idle/, with a separate
	  idle brightness, and provides double-tap-to-wake from the
	  "cst0xx_ts" touch screen through the "aod_dtap" input device.
	  In-tree replacement for the stock aod_idle.ko of the DM63.

	  If unsure, say N.
```
