// SPDX-License-Identifier: GPL-2.0
/*
 * DM82 with the ADF display stack (CONFIG_ADF_SPRD, watch_414_adf.fragment),
 * for the stock Android 8.1 vendor hwcomposer/gralloc, which use ADF.
 *
 * Everything but the display is sp9832e-1h10-dm82.dts; the ADF nodes are
 * sp9832e-watch-adf.dtsi. The DM82 dts enables iommu_dispc with the sharkle
 * default iova (0x70000000 + 0x8000000), which is the stock DM82 one.
 *
 * Panels: all 9 stock /lcds nodes, generated from the stock DT by
 * devices/stock_lcds_to_dtsi.py (lcd/dm82_stock_lcds_adf.dtsi). The
 * bootloader's lcd_id=ID<hex> selects the node named lcd<hex>; as in the
 * DRM dts, the unit's lcd_id is not known, so there is no default panel.
 */

#include "sp9832e-1h10-dm82.dts"
#include "sp9832e-watch-adf.dtsi"

/ {
	lcds {
		#include "lcd/dm82_stock_lcds_adf.dtsi"
	};

	sprd-panel-if {
		panel-drivers = <&dm82_lcd7797 &dm82_lcd9b71
				 &dm82_lcd3310143 &dm82_lcd5300175 &dm82_lcd13613143 &dm82_lcd8601143
				 &dm82_lcd77916150 &dm82_lcd63353 &dm82_lcdffff>;
	};
};
