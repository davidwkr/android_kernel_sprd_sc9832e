// SPDX-License-Identifier: GPL-2.0
/*
 * MT107 with the ADF display stack (CONFIG_ADF_SPRD, watch_414_adf.fragment),
 * for the stock Android 8.1 vendor hwcomposer/gralloc, which use ADF.
 *
 * Everything but the display is sp9832e-1h10-mt107.dts; the ADF nodes are
 * sp9832e-watch-adf.dtsi. The MT107 dts already enables iommu_dispc with the
 * stock iova (0x70000000 + 0x9600000).
 *
 * Panels: all 20 stock /lcds nodes, generated from the stock DT by
 * devices/stock_lcds_to_dtsi.py (lcd/mt107_stock_lcds_adf.dtsi). The
 * bootloader's lcd_id=ID<hex> selects the node named lcd<hex>.
 */

#include "sp9832e-1h10-mt107.dts"
#include "sp9832e-watch-adf.dtsi"

/ {
	lcds {
		#include "lcd/mt107_stock_lcds_adf.dtsi"
	};

	sprd-panel-if {
		panel-drivers = <&mt107_lcd9b71 &mt107_lcd9b71182
				 &mt107_lcd779167 &mt107_lcd77916 &mt107_lcd77916385 &mt107_lcd985520
				 &mt107_lcd77916200 &mt107_lcd7797 &mt107_lcd7801 &mt107_lcd13613
				 &mt107_lcd8601204 &mt107_lcd86011952 &mt107_lcd5300178 &mt107_lcd53001952
				 &mt107_lcd5300204 &mt107_lcd5300206 &mt107_lcd5300213 &mt107_lcd13613213
				 &mt107_lcd3311148 &mt107_lcdffff>;
	};
};
