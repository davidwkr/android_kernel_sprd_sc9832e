// SPDX-License-Identifier: GPL-2.0
/*
 * K18 (sp9832e/sharkle) panel data for the ADF display stack
 * (CONFIG_ADF_SPRD), ICNA3311 148 variant.
 *
 * This is the stock lcd3311148@3311148 node from the 4.4 ground truth
 * (devices/k18/stock.dts in the 4.4 tree), copied property-for-property
 * into the sprd_panel.c DT binding (the same "panel-drivers" phandle +
 * if-type/work-mode/init-data scheme sprd_panel.c's panel_info_attach()
 * parses, distinct from the DRM generic-mipi-panel binding used by
 * lcd_icna3311_oled148_mipi.dtsi). See devices/k18/DTS_414.md for the
 * decoded init/sleep streams, timings and brightness-table provenance
 * (same panel, so the same facts apply here).
 *
 * Not yet referenced by any board .dts: wiring it into a live K18 ADF
 * board variant also needs a "lcds"-style parent node and the dispc/dsi/
 * dphy nodes switched from the DRM bindings to the ones sprd_adf.c's
 * probe expects (see devices/ADF_414_PORT.md, "Open items").
 */

lcd_icna3311_oled148_adf: lcd3311148@3311148 {
	work-mode = <0x00>;
	bpp = <0x18>;
	lane-number = <0x01>;
	need-check-esd = <0x00>;
	esd-timeout = <0x7d0>;
	esd-check-reg = <0x0a>;
	esd-return-code = <0x9c>;
	fps = <0x3c>;
	width-mm = <0x44>;
	height-mm = <0x79>;
	panel-name = "lcd_icna3311_oled148_mipi";
	power-on-sequence = <0x21 0x01 0x14 0x32 0x01 0x14 0x32 0x00 0x14 0x32 0x01 0x32>;
	power-off-sequence = <0x32 0x00 0x14 0x21 0x00 0x14>;
	init-data = <0x23000002 0xfe002300 0x23a77 0x23000002 0x35002300 0x25320 0x23000002 0x51002300 0x263ff 0x29000005 0x2a000001 0xdf290000 0x52b0000 0x1df1378 0x11113 0x14000129>;
	sleep-in = [13 0a 00 01 28 13 78 00 01 10];
	sleep-out = [13 78 00 01 11 13 32 00 01 29];
	aod-in = [23 00 00 02 fe 00 13 0a 00 01 39];
	aod-out = [23 00 00 02 fe 00 13 0a 00 01 38];

	display-timings {
		clock-frequency = <0x704e0>;
		hactive = <0x1e0>;
		vactive = <0x1e0>;
		hback-porch = <0x18>;
		hfront-porch = <0x20>;
		hsync-len = <0x04>;
		vfront-porch = <0x08>;
		vback-porch = <0x04>;
		vsync-len = <0x02>;
	};

	oled-backlight {
		default-brightness = <0x78>;
		max-level = <0xff>;
		/* Identity table (DCS 23 0a 00 02 51 NN, NN = index), same
		 * as every stock brightness table for this panel family
		 * (devices/k18/DTS_414.md): 256 entries, one per 8-bit
		 * level, copied unchanged from the stock lcd3311148 node.
		 */
		brightness-levels = <0x230a0002 0x5100230a 0x25101 0x230a0002 0x5102230a 0x25103 0x230a0002 0x5104230a 0x25105 0x230a0002 0x5106230a 0x25107 0x230a0002 0x5108230a 0x25109 0x230a0002 0x510a230a 0x2510b 0x230a0002 0x510c230a 0x2510d 0x230a0002 0x510e230a 0x2510f 0x230a0002 0x5110230a 0x25111 0x230a0002 0x5112230a 0x25113 0x230a0002 0x5114230a 0x25115 0x230a0002 0x5116230a 0x25117 0x230a0002 0x5118230a 0x25119 0x230a0002 0x511a230a 0x2511b 0x230a0002 0x511c230a 0x2511d 0x230a0002 0x511e230a 0x2511f 0x230a0002 0x5120230a 0x25121 0x230a0002 0x5122230a 0x25123 0x230a0002 0x5124230a 0x25125 0x230a0002 0x5126230a 0x25127 0x230a0002 0x5128230a 0x25129 0x230a0002 0x512a230a 0x2512b 0x230a0002 0x512c230a 0x2512d 0x230a0002 0x512e230a 0x2512f 0x230a0002 0x5130230a 0x25131 0x230a0002 0x5132230a 0x25133 0x230a0002 0x5134230a 0x25135 0x230a0002 0x5136230a 0x25137 0x230a0002 0x5138230a 0x25139 0x230a0002 0x513a230a 0x2513b 0x230a0002 0x513c230a 0x2513d 0x230a0002 0x513e230a 0x2513f 0x230a0002 0x5140230a 0x25141 0x230a0002 0x5142230a 0x25143 0x230a0002 0x5144230a 0x25145 0x230a0002 0x5146230a 0x25147 0x230a0002 0x5148230a 0x25149 0x230a0002 0x514a230a 0x2514b 0x230a0002 0x514c230a 0x2514d 0x230a0002 0x514e230a 0x2514f 0x230a0002 0x5150230a 0x25151 0x230a0002 0x5152230a 0x25153 0x230a0002 0x5154230a 0x25155 0x230a0002 0x5156230a 0x25157 0x230a0002 0x5158230a 0x25159 0x230a0002 0x515a230a 0x2515b 0x230a0002 0x515c230a 0x2515d 0x230a0002 0x515e230a 0x2515f 0x230a0002 0x5160230a 0x25161 0x230a0002 0x5162230a 0x25163 0x230a0002 0x5164230a 0x25165 0x230a0002 0x5166230a 0x25167 0x230a0002 0x5168230a 0x25169 0x230a0002 0x516a230a 0x2516b 0x230a0002 0x516c230a 0x2516d 0x230a0002 0x516e230a 0x2516f 0x230a0002 0x5170230a 0x25171 0x230a0002 0x5172230a 0x25173 0x230a0002 0x5174230a 0x25175 0x230a0002 0x5176230a 0x25177 0x230a0002 0x5178230a 0x25179 0x230a0002 0x517a230a 0x2517b 0x230a0002 0x517c230a 0x2517d 0x230a0002 0x517e230a 0x2517f 0x230a0002 0x5180230a 0x25181 0x230a0002 0x5182230a 0x25183 0x230a0002 0x5184230a 0x25185 0x230a0002 0x5186230a 0x25187 0x230a0002 0x5188230a 0x25189 0x230a0002 0x518a230a 0x2518b 0x230a0002 0x518c230a 0x2518d 0x230a0002 0x518e230a 0x2518f 0x230a0002 0x5190230a 0x25191 0x230a0002 0x5192230a 0x25193 0x230a0002 0x5194230a 0x25195 0x230a0002 0x5196230a 0x25197 0x230a0002 0x5198230a 0x25199 0x230a0002 0x519a230a 0x2519b 0x230a0002 0x519c230a 0x2519d 0x230a0002 0x519e230a 0x2519f 0x230a0002 0x51a0230a 0x251a1 0x230a0002 0x51a2230a 0x251a3 0x230a0002 0x51a4230a 0x251a5 0x230a0002 0x51a6230a 0x251a7 0x230a0002 0x51a8230a 0x251a9 0x230a0002 0x51aa230a 0x251ab 0x230a0002 0x51ac230a 0x251ad 0x230a0002 0x51ae230a 0x251af 0x230a0002 0x51b0230a 0x251b1 0x230a0002 0x51b2230a 0x251b3 0x230a0002 0x51b4230a 0x251b5 0x230a0002 0x51b6230a 0x251b7 0x230a0002 0x51b8230a 0x251b9 0x230a0002 0x51ba230a 0x251bb 0x230a0002 0x51bc230a 0x251bd 0x230a0002 0x51be230a 0x251bf 0x230a0002 0x51c0230a 0x251c1 0x230a0002 0x51c2230a 0x251c3 0x230a0002 0x51c4230a 0x251c5 0x230a0002 0x51c6230a 0x251c7 0x230a0002 0x51c8230a 0x251c9 0x230a0002 0x51ca230a 0x251cb 0x230a0002 0x51cc230a 0x251cd 0x230a0002 0x51ce230a 0x251cf 0x230a0002 0x51d0230a 0x251d1 0x230a0002 0x51d2230a 0x251d3 0x230a0002 0x51d4230a 0x251d5 0x230a0002 0x51d6230a 0x251d7 0x230a0002 0x51d8230a 0x251d9 0x230a0002 0x51da230a 0x251db 0x230a0002 0x51dc230a 0x251dd 0x230a0002 0x51de230a 0x251df 0x230a0002 0x51e0230a 0x251e1 0x230a0002 0x51e2230a 0x251e3 0x230a0002 0x51e4230a 0x251e5 0x230a0002 0x51e6230a 0x251e7 0x230a0002 0x51e8230a 0x251e9 0x230a0002 0x51ea230a 0x251eb 0x230a0002 0x51ec230a 0x251ed 0x230a0002 0x51ee230a 0x251ef 0x230a0002 0x51f0230a 0x251f1 0x230a0002 0x51f2230a 0x251f3 0x230a0002 0x51f4230a 0x251f5 0x230a0002 0x51f6230a 0x251f7 0x230a0002 0x51f8230a 0x251f9 0x230a0002 0x51fa230a 0x251fb 0x230a0002 0x51fc230a 0x251fd 0x230a0002 0x51fe230a 0x251ff>;
	};
};
