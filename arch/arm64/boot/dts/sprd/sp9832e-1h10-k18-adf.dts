// SPDX-License-Identifier: GPL-2.0
/*
 * K18 with the ADF display stack (CONFIG_ADF_SPRD, watch_414_adf.fragment),
 * for the stock Android 8.1 vendor hwcomposer/gralloc, which use ADF.
 *
 * Everything but the display is sp9832e-1h10-k18.dts; the ADF nodes are
 * sp9832e-watch-adf.dtsi. The K18 dts already enables iommu_dispc with the
 * stock iova (0x70000000 + 0x9600000) and the ION heaps (overlay 2, fb 3,
 * camera 4) match stock. The boot logo address comes from lcd_base= as in
 * stock.
 *
 * Panel: the bootloader's lcd_id=ID3311148 selects the panel-drivers node
 * named lcd3311148 (sprd_panel.c); the unit reports the ICNA3311 148 panel.
 */

#include "sp9832e-1h10-k18.dts"
#include "sp9832e-watch-adf.dtsi"

/ {
	lcds {
		#include "lcd/lcd_icna3311_oled148_adf.dtsi"
	};

	sprd-panel-if {
		panel-drivers = <&lcd_icna3311_oled148_adf>;
	};
};
